/*
  OzOLED.cpp - 0.96' I2C 128x64 OLED Driver Library
  2014 Copyright (c) OscarLiang.net  All right reserved.
 
  Author: Oscar Liang
  
  This library is free software; you can redistribute it and/or
  modify it under the terms of the GNU Lesser General Public
  License as published by the Free Software Foundation; either
  version 2.1 of the License, or (at your option) any later version.

  This library is distributed in the hope that it will be useful,
  but WITHOUT ANY WARRANTY; without even the implied warranty of
  MERCHANTABILITY or FITNESS FOR A PARTICULAR PURPOSE.  See the GNU
  Lesser General Public License for more details.

*/




#include "OzOLED.h"
#include <Wire.h>
#include <avr/pgmspace.h>


// 8x8 Font ASCII 32 - 127 Implemented
// Users can modify this to support more characters(glyphs)
// BasicFont is placed in code memory.

// This font be freely used without any restriction(It is placed in public domain)
const byte BasicFont[][8] PROGMEM = {
	{0x00,0x00,0x00,0x00,0x00,0x00,0x00,0x00},
	{0x00,0x00,0x5F,0x00,0x00,0x00,0x00,0x00},
	{0x00,0x00,0x07,0x00,0x07,0x00,0x00,0x00},
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	{0x00,0x02,0x05,0x05,0x02,0x00,0x00,0x00} 
};


// Big numbers font, from 0 to 9 - 96 bytes each.
const byte bigNumbers [][96] PROGMEM = {
{0x00, 0x00, 0x00, 0xC0, 0xE0, 0xF0, 0xF0, 0xF0, 0xF0, 0xF0, 0xF0, 0xF0, 0xF0, 0xF0, 0xF0, 0xF0,
0xF0, 0xF0, 0xF0, 0xE0, 0xC0, 0x00, 0x00, 0x00, 0x00, 0x00, 0x00, 0xFF, 0xFF, 0xFF, 0xFF, 0x01,
0x00, 0x00, 0x00, 0x00, 0x00, 0x00, 0x00, 0x00, 0x01, 0xFF, 0xFF, 0xFF, 0xFF, 0x00, 0x00, 0x00,
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0x00, 0x00, 0x01, 0x01, 0x01, 0x01, 0x00, 0x00, 0x00, 0x00, 0x00, 0x00, 0x00, 0x00, 0x00, 0x00}
};





// ====================== LOW LEVEL =========================

void OzOLED::sendCommand(byte command){
	Wire.beginTransmission(OLED_ADDRESS); // begin transmitting
	Wire.write(OzOLED_COMMAND_MODE);//data mode
	Wire.write(command);
	Wire.endTransmission();    // stop transmitting
}


void OzOLED::sendData(byte data){
	
	Wire.beginTransmission(OLED_ADDRESS); // begin transmitting
	Wire.write(OzOLED_DATA_MODE);//data mode
	Wire.write(data);
	Wire.endTransmission();    // stop transmitting

}

void OzOLED::printChar(char C, byte X, byte Y){

	if ( X < 128 )
		setCursorXY(X, Y);

	//Ignore unused ASCII characters. Modified the range to support multilingual characters.
    if(C < 32 || C > 127)
		C='*'; //star - indicate characters that can't be displayed

	
    for(byte i=0; i<8; i++) {
	
       //read bytes from code memory
       sendData(pgm_read_byte(&BasicFont[C-32][i])); //font array starts at 0, ASCII starts at 32. Hence the translation
	 
    }
}

void OzOLED::printString(const char *String, byte X, byte Y, byte numChar){

	if ( X < 128 )
		setCursorXY(X, Y);

	
	byte count=0;
    while(String[count] && count<numChar){
		printChar(String[count++]);  
	}

}


byte OzOLED::printNumber(long long_num, byte X, byte Y){

	if ( X < 128 )
		setCursorXY(X, Y);


	byte char_buffer[10] = "";
	byte i = 0;
	byte f = 0; // number of characters

	if (long_num < 0) {
	
		f++;
		printChar('-');
		long_num = -long_num;
	
	} 
	else if (long_num == 0) {
	
		f++;
		printChar('0');
		return f;
	
	} 

	while (long_num > 0) {
	
		char_buffer[i++] = long_num % 10;
		long_num /= 10;
	
	}

	f += i;
	for(; i > 0; i--) {

		printChar('0'+ char_buffer[i - 1]);

	}
	
	return f;

}




byte OzOLED::printNumber(float float_num, byte prec, byte X, byte Y){

	if ( X < 128 )
		setCursorXY(X, Y);

// prec - 6 maximum

	byte num_int = 0;
	byte num_frac = 0;
	byte num_extra = 0;
	
	long d = float_num; // get the integer part
	float f = float_num - d; // get the fractional part
	
	
	if (d == 0 && f < 0.0){
	
		printChar('-');
		num_extra++;
		printChar('0');
		num_extra++;
		f *= -1;
		
	}
	else if (d < 0 && f < 0.0){
	
		num_int = printNumber(d); // count how many digits in integer part
		f *= -1;
		
	}
	else{
	
		num_int = printNumber(d); // count how many digits in integer part
	
	}
	
	// only when fractional part > 0, we show decimal point
	if (f > 0.0){
	
		printChar('.');
		num_extra++;
	
		long f_shift = 1;
		
		if (num_int + prec > 8) 
			prec = 8 - num_int;
		
		for (byte j=0; j<prec; j++){
			f_shift *= 10;
		}

		num_frac = printNumber((long)(f*f_shift)); // count how many digits in fractional part
		
	}
	
	return num_int + num_frac + num_extra;

}



void OzOLED::printBigNumber(const char *number, byte X, byte Y, byte numChar){
// big number pixels: 24 x 32

 // Y - page
	byte column = 0;
	byte count = 0;

	while(number[count] && count<numChar){
	
	
		setCursorXY(X, Y);
		
		for(byte i=0; i<96; i++) {
		
			// if character is not "0-9" or ':'
			if(number[count] < 48 || number[count] > 58)	
				sendData(0);
			else 				
				sendData(pgm_read_byte(&bigNumbers[number[count]-48][i]));
			
			
			if(column >= 23){
				column = 0;
				setCursorXY(X, ++Y);
			}
			else				
				column++;

		}
		
		count++;
		
		X = X + 3;
		Y = Y - 4;
		
	
	}

	
	
}


void OzOLED::drawBitmap(const byte *bitmaparray, byte X, byte Y, byte width, byte height){

// max width = 16
// max height = 8

	setCursorXY( X, Y );
	
	byte column = 0; 
	for(int i=0; i<width*8*height; i++) {  

		sendData(pgm_read_byte(&bitmaparray[i]));
		
		if(++column == width*8) {
			column = 0;
			setCursorXY( X, ++Y );
		} 
	}

}


void OzOLED::VertBar(int Num, int Val, int MinVal, int MaxVal)
{
	if (Val < MinVal) Val = MinVal;            // consider that Val already scaled
	if (Val > MaxVal) Val = MaxVal;
	Val -= MinVal;
    for (int i = 0; i < 8; i++)              // go from high levels to low ones
	{
		setCursorXY_L(Num, i);
    int b;                                   // will calc this value for each columns (bars)
		int UpB = (MaxVal - MinVal)*(8-i)/8;
    if (Val <= UpB)                          // top boundary
		{
			int DownB = (MaxVal - MinVal)*(7-i)/8;
      if (Val >= DownB)                      // bottom boundary
      {                                      // Val are in this interval
				int j = (Val - DownB)*8/(UpB - DownB);
				int k = 0xFF00;
				b = (k >> j) & 0xFF;
			}
			else
			{
				b = 0;
			}
		}
		else
		{
			b = 0xFF;
		}
		sendData(b);
	}
  setCursorXY(0, 0);
}


void OzOLED::setCursorXY_L(byte X, byte Y){
	// Y - 1 unit = 1 page (8 pixel rows)
	// X - 1 unit = 8 pixel columns

    sendCommand(0x00 + (X & 0x0F)); 		//set column lower address
    sendCommand(0x10 + ((X>>4)&0x0F)); 	//set column higher address
	sendCommand(0xB0 + Y); 					//set page address
	
}






// =================== High Level ===========================


void OzOLED::init(){
	Wire.begin();
	
	// upgrade to 400KHz! (only use when your other i2c device support this speed)
	if (I2C_400KHZ){
		// save I2C bitrate (default 100Khz)
		byte twbrbackup = TWBR;
		TWBR = 12; 
		//TWBR = twbrbackup;
		//Serial.println(TWBR, DEC);
		//Serial.println(TWSR & 0x3, DEC);
// Additional command
    OzOled.setPowerOff();
/*A8h, 3Fh      Set MUX Ratio                  
D3h, 00h      Set Display Offset            
40h             Set Display Start Line       
A0h/A1h      Set Segment re-map       
C0h/C8h     Set COM Output Scan Direction     
DAh, 02h     Set COM Pins hardware configuration     
81h, 7Fh      Set Contrast Control                  
A4h             Disable Entire Display On           
A6h             Set Normal Display                    
D5h, 80h     Set Osc Frequency                    
8Dh, 14h     Enable charge pump regulator   
AFh             Display On                    ��� �� �������� */
    OzOled.sendCommand(ASA_SET_DISPLAY_CLOCK_DIV_RATIO);
    OzOled.sendCommand(0x80);
    OzOled.sendCommand(ASA_SET_MULTIPLEX_RATIO);
    OzOled.sendCommand(0x3F);
    OzOled.sendCommand(ASA_SET_DISPLAY_OFFSET);
    OzOled.sendCommand(0x0);
    OzOled.sendCommand(ASA_SET_START_LINE | 0x0);
    OzOled.sendCommand(ASA_CHARGE_PUMP);
        OzOled.sendCommand(0x14);
    OzOled.sendCommand(ASA_MEMORY_ADDR_MODE);
    OzOled.sendCommand(0x00);
    OzOled.sendCommand(ASA_SET_SEGMENT_REMAP | 0x1);
    OzOled.sendCommand(ASA_COM_SCAN_DIR_DEC);
    OzOled.sendCommand(ASA_SET_COM_PINS);
    OzOled.sendCommand(0x12);
    OzOled.setBrightness(0xCF);
    OzOled.sendCommand(ASA_SET_PRECHARGE_PERIOD);
        OzOled.sendCommand(0xF1);
    OzOled.sendCommand(ASA_SET_VCOM_DESELECT);
    OzOled.sendCommand(0x40);
    OzOled.sendCommand(ASA_DISPLAY_ALL_ON_RESUME);
    OzOled.setNormalDisplay();
    OzOled.setPowerOn();

	}
	
    setPowerOff(); 	//display off
    delay(10);
    setPowerOn();	//display on
    delay(10); 
    setNormalDisplay();  //default Set Normal Display
	setPageMode();	// default addressing mode
	clearDisplay();
	setCursorXY(0,0);
	

}

void OzOLED::setCursorXY(byte X, byte Y){
	// Y - 1 unit = 1 page (8 pixel rows)
	// X - 1 unit = 8 pixel columns

    sendCommand(0x00 + (8*X & 0x0F)); 		//set column lower address
    sendCommand(0x10 + ((8*X>>4)&0x0F)); 	//set column higher address
	sendCommand(0xB0 + Y); 					//set page address
	
}


void OzOLED::clearDisplay()	{


	for(byte page=0; page<8; page++) {	
	
		setCursorXY(0, page);     
		for(byte column=0; column<128; column++){  //clear all columns
			sendData(0);    
		}

	}
	
	setCursorXY(0,0);  
	
}

/*
void OzOLED::clearPage(byte page)	{
	// clear page and set cursor at beginning of that page

	setCursorXY(0, page);    
	for(byte column=0; column<128; column++){  //clear all columns
		sendData(0x00);    
	}
	
}
*/


void OzOLED::setInverseDisplay(){

	sendCommand(OzOLED_CMD_INVERSE_DISPLAY);
	
}

void OzOLED::setNormalDisplay(){

	sendCommand(OzOLED_CMD_NORMAL_DISPLAY);
	
}

void OzOLED::setPowerOff(){

	sendCommand(OzOLED_CMD_DISPLAY_OFF);
	
}

void OzOLED::setPowerOn(){

	sendCommand(OzOLED_CMD_DISPLAY_ON);
	
}

void OzOLED::setBrightness(byte Brightness){

	sendCommand(OzOLED_CMD_SET_BRIGHTNESS);
	sendCommand(Brightness);
   
}

void OzOLED::setPageMode(){
	addressingMode = PAGE_ADDRESSING;
	sendCommand(0x20); 				//set addressing mode
	sendCommand(PAGE_ADDRESSING); 	//set page addressing mode
}

void OzOLED::setHorizontalMode(){
	addressingMode = HORIZONTAL_ADDRESSING;
	sendCommand(0x20); 				//set addressing mode
	sendCommand(HORIZONTAL_ADDRESSING); 	//set page addressing mode
}


// startscrollright
// Activate a right handed scroll for rows start through stop
// Hint, the display is 16 rows tall. To scroll the whole display, run:
// scrollRight(0x00, 0x0F)  - start - stop
void OzOLED::scrollRight(byte start, byte end, byte speed){

    sendCommand(OzOLED_RIGHT_SCROLL);  //Horizontal Scroll Setup
    sendCommand(0x00);	// dummy byte 
    sendCommand(start);	// start page address
    sendCommand(speed);	// set time interval between each scroll
    sendCommand(end);	// end page address
	
    sendCommand(0x01);  
    sendCommand(0xFF);
	
    sendCommand(0x2f);  //active scrolling
	
}


// startscrollleft
// Activate a right handed scroll for rows start through stop
// Hint, the display is 16 rows tall. To scroll the whole display, run:
// display.scrollright(0x00, 0x0F)   - start - stop
void OzOLED::scrollLeft(byte start, byte end, byte speed){

    sendCommand(OzOLED_LEFT_SCROLL);  //Horizontal Scroll Setup
    sendCommand(0x00);	// dummy byte
    sendCommand(start);	// start page address
    sendCommand(speed);	// set time interval between each scroll
    sendCommand(end);	// end page address
	
    sendCommand(0x01);  
    sendCommand(0xFF);  
	
    sendCommand(0x2f);  //active scrolling
	
}

// startscrolldiagright
// Activate a diagonal scroll for rows start through stop
// Hint, the display is 16 rows tall. To scroll the whole display, run:
// display.scrollright(0x00, 0x0F) 
void OzOLED::scrollDiagRight(){

        sendCommand(OzOLED_SET_VERTICAL_SCROLL_AREA);        
        sendCommand(0X00);
        sendCommand(OzOLED_Max_Y);
        sendCommand(OzOLED_VERTICAL_RIGHT_SCROLL); //Vertical and Horizontal Scroll Setup
        sendCommand(0X00); 	//dummy byte
        sendCommand(0x00);	 //define page0 as startpage address
        sendCommand(0X00);	//set time interval between each scroll ste as 6 frames
        sendCommand(0x07);	//define page7 as endpage address
        sendCommand(0X01);	//set vertical scrolling offset as 1 row
        sendCommand(OzOLED_CMD_ACTIVATE_SCROLL); //active scrolling
	
}

void OzOLED::scrollDiagLeft(){

        sendCommand(OzOLED_SET_VERTICAL_SCROLL_AREA);        
        sendCommand(0X00);
        sendCommand(OzOLED_Max_Y);
        sendCommand(OzOLED_VERTICAL_LEFT_SCROLL); //Vertical and Horizontal Scroll Setup
        sendCommand(0X00); //dummy byte
        sendCommand(0x00);	 //define page0 as startpage address
        sendCommand(0X00);	//set time interval between each scroll ste as 6 frames
        sendCommand(0x07);	//define page7 as endpage address
        sendCommand(0X01);	//set vertical scrolling offset as 1 row
        sendCommand(OzOLED_CMD_ACTIVATE_SCROLL); //active scrolling
	
}


void OzOLED::setActivateScroll(byte direction, byte startPage, byte endPage, byte scrollSpeed){


/*
This function is still not complete, we need more testing also.
Use the following defines for 'direction' :

 Scroll_Left			
 Scroll_Right			

For Scroll_vericle, still need to debug more... 

Use the following defines for 'scrollSpeed' :

 Scroll_2Frames		
 Scroll_3Frames
 Scroll_4Frames
 Scroll_5Frames	
 Scroll_25Frames
 Scroll_64Frames
 Scroll_128Frames
 Scroll_256Frames

*/


	if(direction == Scroll_Right) {
	
		//Scroll Right
		sendCommand(0x26);
		
	}
	else {
	
		//Scroll Left  
		sendCommand(0x27);

	}
	/*
	else if (direction == Scroll_Up ){
	
		//Scroll Up  
		sendCommand(0x29);
	
	}
	else{
	
		//Scroll Down  
		sendCommand(0x2A);
	
	}
	*/
	sendCommand(0x00);//dummy byte
	sendCommand(startPage);
	sendCommand(scrollSpeed);	
	sendCommand(endPage);		// for verticle scrolling, use 0x29 as command, endPage should = start page = 0
	
	/*
	if(direction == Scroll_Up) {
	
		sendCommand(0x01);

	}
	*/

	sendCommand(OzOLED_CMD_ACTIVATE_SCROLL);

}

void OzOLED::setDeactivateScroll(){

	sendCommand(OzOLED_CMD_DEACTIVATE_SCROLL);

}

unsigned int EnlardeByte2Word(char b)
{
    unsigned int d = 0;
    for (byte i = 0; i < 8; i++)
    {
        unsigned int e = (((unsigned int)b) & (1 << i)) << i;
        d = d | e | (e << 1);
    }
    return d;
}

void OzOLED::printChar16(char C, byte X, byte Y){
    setCursorXY(X, Y);
    if(C < 32 || C > 127)        //Ignore unused ASCII characters.
        C='*';        //star - indicate characters that can't be displayed
    unsigned int m = 0;
    unsigned char n[8];

    for ( byte i=0; i<8; i++) {
        m = EnlardeByte2Word(pgm_read_byte(&BasicFont[C-32][i]));
        sendData(lowByte(m));
        sendData(lowByte(m));
        n[i] = highByte(m);
    }
    setCursorXY(X, Y+1);

    for(byte i=0; i<8; i++) {
        sendData(n[i]); //font array starts at 0, ASCII starts at 32. Hence the translation
        sendData(n[i]); //font array starts at 0, ASCII starts at 32. Hence the translation
    }
}

void OzOLED::printString16(const char *String, byte X, byte Y, byte numChar){
    byte count=0;
    while(String[count] && count<numChar){
        printChar16(String[count++], X, Y);
        X += 2;
    }

}

void OzOLED::printChar12a(char C, byte X, byte Y){
    setCursorX2Y(X, Y);
    if(C < 32 || C > 127)        //Ignore unused ASCII characters.
        C='*';        //star - indicate characters that can't be displayed
    unsigned int m = 0;
    unsigned char n[8];

    for ( byte i=0; i<4; i++) {
        m = EnlardeByte2Word(pgm_read_byte(&BasicFont[C-32][2*i]));
        n[2*i] = highByte(m);
        sendData(lowByte(m));
        sendData(lowByte(m));
        m = EnlardeByte2Word(pgm_read_byte(&BasicFont[C-32][2*i+1]));
        sendData(lowByte(m));
        n[2*i+1] = highByte(m);
    }
    setCursorX2Y(X, Y+1);

    for(byte i=0; i<4; i++) {
        sendData(n[2*i]);
        sendData(n[2*i]);
        sendData(n[2*i+1]);
    }
}

void OzOLED::printString12a(const char *String, byte X, byte Y, byte numChar){
    byte count=0;
    while(String[count] && count<numChar){
        printChar12a(String[count++], X, Y);
        X += 3;
    }
}

void OzOLED::printChar12b(char C, byte X, byte Y){
    setCursorX2Y(X, Y);
    if(C < 32 || C > 127)        //Ignore unused ASCII characters.
        C='*';        //star - indicate characters that can't be displayed
    unsigned int m = 0;
    unsigned char n[8];

    for ( byte i=0; i<4; i++) {
        m = EnlardeByte2Word(pgm_read_byte(&BasicFont[C-32][2*i]));
        n[2*i] = highByte(m);
        sendData(lowByte(m));
        m = EnlardeByte2Word(pgm_read_byte(&BasicFont[C-32][2*i+1]));
        sendData(lowByte(m));
        sendData(lowByte(m));
        n[2*i+1] = highByte(m);
    }
    setCursorX2Y(X, Y+1);

    for(byte i=0; i<4; i++) {
        sendData(n[2*i]);
        sendData(n[2*i+1]);
        sendData(n[2*i+1]);
    }
}

void OzOLED::printString12b(const char *String, byte X, byte Y, byte numChar){
    byte count=0;
    while(String[count] && count<numChar){
        printChar12b(String[count++], X, Y);
        X += 3;
    }
}

void OzOLED::setCursorX2Y(byte X, byte Y){
    // Y - 1 unit = 1 page (8 pixel rows)
    // X - 1 unit = 4 pixel columns - half of character cell - for 12-pix fonts

    sendCommand(0x00 + (4*X & 0x0F));         //set column lower address
    sendCommand(0x10 + ((4*X>>4)&0x0F));     //set column higher address
    sendCommand(0xB0 + Y);                     //set page address
}




OzOLED OzOled;  // Preinstantiate Objects

